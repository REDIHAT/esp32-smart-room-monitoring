## sdkconfig.defaults
```kconfig
# HTTP Server configuration
CONFIG_HTTPD_MAX_REQ_HDR_LEN=1024
CONFIG_HTTPD_MAX_URI_LEN=512
CONFIG_HTTPD_ERR_RESP_NO_DELAY=y

# FreeRTOS configuration
CONFIG_FREERTOS_HZ=1000

# ESP32 system event queue
CONFIG_ESP_SYSTEM_EVENT_QUEUE_SIZE=32
```
